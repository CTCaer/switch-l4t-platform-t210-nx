/*
 * Copyright (c) 2019-2020, Billy Laws <blaws05@gmail.com>
 * Copyright (c) 2019-2022, CTCaer <ctcaer@gmail.com>
 *
 * This program is free software; you can redistribute it and/or modify
 * it under the terms of the GNU General Public License as published by
 * the Free Software Foundation; version 2 of the License.
 *
 * This program is distributed in the hope that it will be useful, but WITHOUT
 * ANY WARRANTY; without even the implied warranty of MERCHANTABILITY or
 * FITNESS FOR A PARTICULAR PURPOSE.  See the GNU General Public License for
 * more details.
 */

#include <dt-bindings/gpio/tegra-gpio.h>
#include <dt-bindings/soc/tegra-pmc.h>

/ {
	gpio@6000d000 {
		wlan-default-input {
			gpio-hog;
			input;
			gpios = <TEGRA_GPIO(H, 2) 1>;
			label = "wlan-default-input-h2";
		};
	};
	
};
