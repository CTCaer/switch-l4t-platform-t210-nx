/*
 * Copyright (c) 2015-2017, NVIDIA CORPORATION.  All rights reserved.
 *
 * This program is free software; you can redistribute it and/or modify
 * it under the terms of the GNU General Public License as published by
 * the Free Software Foundation; version 2 of the License.
 *
 * This program is distributed in the hope that it will be useful, but WITHOUT
 * ANY WARRANTY; without even the implied warranty of MERCHANTABILITY or
 * FITNESS FOR A PARTICULAR PURPOSE.  See the GNU General Public License for
 * more details.
 */

#include <dt-bindings/gpio/tegra-gpio.h>
#include <dt-bindings/soc/tegra-pmc.h>

/ {
	gpio@6000d000 {
		wlan-default-input {
			gpio-hog;
			input;
			gpios = <TEGRA_GPIO(H, 2) 1>;
			label = "wlan-default-input-h2";
		};
	};

	brcmfmac_pcie_wlan_upstream {
		compatible = "brcm,bcm4356-fmac";
		status = "okay";
		brcm,reset_on_wake;
		nvidia,pmc-wakeup = <&tegra_pmc
				PMC_WAKE_TYPE_EVENT 8 PMC_TRIGGER_TYPE_HIGH>; /* WiFi Wake Ap (H, 2) */
	};
};
