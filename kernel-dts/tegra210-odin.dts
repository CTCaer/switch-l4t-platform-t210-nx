/*
 * Copyright (c) 2019-2020, Billy Laws <blaws05@gmail.com>
 * Copyright (c) 2019-2022, CTCaer <ctcaer@gmail.com>
 *
 * This program is free software; you can redistribute it and/or modify
 * it under the terms of the GNU General Public License as published by
 * the Free Software Foundation; version 2 of the License.
 *
 * This program is distributed in the hope that it will be useful, but WITHOUT
 * ANY WARRANTY; without even the implied warranty of MERCHANTABILITY or
 * FITNESS FOR A PARTICULAR PURPOSE.  See the GNU General Public License for
 * more details.
 *
 */

#include "nx-platforms/tegra210-odin-common.dtsi"
#include "nx-platforms/tegra210-nx-common-disp.dtsi"
#include "nx-platforms/tegra210-odin-power-tree.dtsi"
#include "nx-platforms/tegra210-odin-emc.dtsi"
#include "nx-platforms/tegra210-nx-sensor.dtsi"

/ {
	nvidia,dtsfilename = __FILE__;
	nvidia,dtbbuildtime = __DATE__, __TIME__;

	host1x {
		/* tegradc.0: DSI */
		dc@54200000 {
			nvidia,emc-clk-rate = <300000000>;
		};
	};
};
